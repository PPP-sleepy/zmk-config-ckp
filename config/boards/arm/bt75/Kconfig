## config/boards/arm/bt75/Kconfig
```kconfig
# SPDX-License-Identifier: MIT

config BOARD_ENABLE_DCDC
	bool "Enable DCDC mode"
	select SOC_DCDC_NRF52X
	default y
	depends on BOARD_BT75
CONFIG_ZMK_STUDIO=y
CONFIG_ZMK_STUDIO_LOCKING=n 
```
